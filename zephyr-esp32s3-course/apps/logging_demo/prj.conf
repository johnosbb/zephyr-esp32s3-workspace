## CMakeLists.txt
```
cmake_minimum_required(VERSION 3.20.0)

find_package(Zephyr REQUIRED HINTS $ENV{ZEPHYR_BASE})
project(logging_demo LANGUAGES C)

target_sources(app PRIVATE src/main.c)
```

## prj.conf
```kconfig
# Console + logging
CONFIG_ESPTOOLPY_FLASHSIZE_16MB=y
CONFIG_CONSOLE=y
CONFIG_UART_CONSOLE=y
CONFIG_SERIAL=y
CONFIG_STDOUT_CONSOLE=y

CONFIG_LOG=y
CONFIG_LOG_DEFAULT_LEVEL=3
CONFIG_LOG_MODE_DEFERRED=y
CONFIG_LOG_PROCESS_THREAD=y


# Use minimal C library to avoid picolibc/newlib complications
CONFIG_MINIMAL_LIBC=y
CONFIG_PICOLIBC=n
CONFIG_NEWLIB_LIBC=n
```

## src/main.c
```c
#include <zephyr/kernel.h>
#include <zephyr/logging/log.h>

/* Register the module 'app' and set the visibility level to DEBUG */
LOG_MODULE_REGISTER(app, LOG_LEVEL_DBG);

int main(void)
{
    int counter = 0;
    LOG_INF("System Monitoring Started (Loop: 10ms)");

    while (1) {
        k_msleep(100); 
        counter++;

        /* * LOG_DBG: The High-Resolution "logging"
         * This will fill your buffer quickly.
         * Useful during active development to see every tick.
         */
        LOG_DBG("Processing cycle %d", counter);

        /* * LOG_ERR: Simulating a Critical Event
         */
        if ((counter % 100) == 0) {
            LOG_ERR("Critical: Periodic simulated error at count %d", counter);
        }
    }

    return 0;
}
```
