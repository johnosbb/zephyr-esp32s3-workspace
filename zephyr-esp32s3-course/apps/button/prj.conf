## CMakeLists.txt
```
cmake_minimum_required(VERSION 3.20.0)

find_package(Zephyr REQUIRED HINTS $ENV{ZEPHYR_BASE})
project(button LANGUAGES C)

target_sources(app PRIVATE src/main.c)
```

## prj.conf
```kconfig
# Console + logging
CONFIG_ESPTOOLPY_FLASHSIZE_16MB=y
CONFIG_CONSOLE=y
CONFIG_UART_CONSOLE=y

CONFIG_LOG=y
CONFIG_LOG_DEFAULT_LEVEL=3

# Use minimal C library to avoid picolibc/newlib complications
CONFIG_MINIMAL_LIBC=y
CONFIG_PICOLIBC=n
CONFIG_NEWLIB_LIBC=n

# GPIO + interrupt handling
CONFIG_GPIO=y
```

## src/main.c
```c
#include <zephyr/kernel.h>
#include <zephyr/device.h>
#include <zephyr/drivers/gpio.h>
#include <zephyr/logging/log.h>

LOG_MODULE_REGISTER(button, LOG_LEVEL_INF);

/* Debounce window; increase if your button is especially noisy. */
#define DEBOUNCE_MS 100

/* Pull LED/button GPIO binding from the board's DeviceTree aliases. */
static const struct gpio_dt_spec led = GPIO_DT_SPEC_GET(DT_ALIAS(led0), gpios);
static const struct gpio_dt_spec button = GPIO_DT_SPEC_GET(DT_ALIAS(sw0), gpios);

/* ISR bookkeeping and delayed work for debouncing. */
static struct gpio_callback button_cb_data;
static struct k_work_delayable debounce_work;
/* Tracks whether the current press has already toggled the LED (prevents repeat toggles while held). */
static bool press_latched;

/* Runs in a system work queue context after the debounce delay expires. */
static void debounce_work_handler(struct k_work *work)
{
    int val = gpio_pin_get_dt(&button);
    if (val < 0)
    {
        LOG_ERR("Failed to read button state (%d)", val);
        return;
    }

    /* gpio_pin_get_dt() returns the LOGICAL level, not the raw voltage: it has
     * already applied the GPIO_ACTIVE_LOW inversion from the devicetree.
     * So 1 = active (pressed), 0 = inactive (released). Use the raw accessor
     * gpio_pin_get_raw() if you ever need the actual electrical level instead.
     * (Thanks to Marc Binderberger for catching the inverted test here.)
     */
    bool pressed_now = (val != 0);

    if (pressed_now && !press_latched)
    {
        int rc = gpio_pin_toggle_dt(&led);
        if (rc < 0)
        {
            LOG_ERR("Failed to toggle LED (%d)", rc);
            return;
        }
        LOG_INF("Button pressed; toggling LED");
        press_latched = true;
    }
    else if (!pressed_now && press_latched)
    {
        /* Release detected; unlock for the next press. */
        press_latched = false;
    }
}

/* Interrupt callback: schedule debounced processing on the work queue. */
static void button_pressed(const struct device *dev, struct gpio_callback *cb, uint32_t pins)
{
    ARG_UNUSED(dev);
    ARG_UNUSED(cb);
    ARG_UNUSED(pins);

    k_work_reschedule(&debounce_work, K_MSEC(DEBOUNCE_MS));
}

int main(void)
{
    /* Validate that the GPIO controllers backing the bindings are ready. */
    if (!device_is_ready(led.port) || !device_is_ready(button.port))
    {
        LOG_ERR("LED or button device not ready");
        return 0;
    }

    /* Start with LED off; use the flags baked into the binding. */
    if (gpio_pin_configure_dt(&led, GPIO_OUTPUT_INACTIVE) < 0)
    {
        LOG_ERR("Failed to configure LED");
        return 0;
    }

    if (gpio_pin_configure_dt(&button, GPIO_INPUT) < 0)
    {
        LOG_ERR("Failed to configure button");
        return 0;
    }

    /* Initialize the work item BEFORE anything can trigger it: the ISR
     * reschedules this work, so it must exist before the interrupt is armed.
     */
    k_work_init_delayable(&debounce_work, debounce_work_handler);

    gpio_init_callback(&button_cb_data, button_pressed, BIT(button.pin));
    if (gpio_add_callback(button.port, &button_cb_data) < 0)
    {
        LOG_ERR("Failed to add button callback");
        return 0;
    }

    /* Arm the interrupt LAST. Once enabled, a press can fire at any instant,
     * so the work item and callback above must already be initialized.
     * Use both edges: press starts debounce, release clears the latch.
     */
    if (gpio_pin_interrupt_configure_dt(&button, GPIO_INT_EDGE_BOTH) < 0)
    {
        LOG_ERR("Failed to enable button interrupt");
        return 0;
    }
    LOG_INF("Button demo ready; press the button to toggle the LED.");

    while (1)
    {
        /* Sleep forever; all work happens via the interrupt + work queue. */
        k_sleep(K_SECONDS(1));
    }

    return 0;
}
```
