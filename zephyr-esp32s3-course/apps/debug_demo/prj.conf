## CMakeLists.txt
```
cmake_minimum_required(VERSION 3.20.0)

find_package(Zephyr REQUIRED HINTS $ENV{ZEPHYR_BASE})
project(debug_demo LANGUAGES C)

target_sources(app PRIVATE src/main.c)
```

## prj.conf
```kconfig
# Core logging + GPIO
CONFIG_LOG=y
CONFIG_LOG_DEFAULT_LEVEL=3
CONFIG_GPIO=y
CONFIG_MAIN_STACK_SIZE=4096
CONFIG_ESPTOOLPY_FLASHSIZE_16MB=y

# C library selection (avoid picolibc/newlib clashes)
CONFIG_MINIMAL_LIBC=y
CONFIG_PICOLIBC=n
CONFIG_NEWLIB_LIBC=n

# Console via USB Serial/JTAG (see overlay)
CONFIG_CONSOLE=y
CONFIG_SERIAL=y
CONFIG_UART_CONSOLE=y
CONFIG_STDOUT_CONSOLE=y

# Debug-friendly options
CONFIG_DEBUG=y
CONFIG_DEBUG_THREAD_INFO=y
CONFIG_ASSERT=y
CONFIG_DEBUG_OPTIMIZATIONS=y
# Optimization friendly debug
CONFIG_DEBUG_INFO=y
# CONFIG_NO_OPTIMIZATIONS=y # unfortunately this causes instability issues on the esp32-s3

# Optional sensor stubs (handy for adding watchpoints later)
CONFIG_I2C=y
CONFIG_SENSOR=y
CONFIG_SHT4X=y
```

## boards/esp32s3_devkitc.overlay
```dts
/*
 * The "chosen" node tells Zephyr which hardware to use for certain
 * core subsystems (console, shell, etc).
 *
 * Here we direct both the console and shell to the USB Serial/JTAG
 * interface provided by the ESP32-S3. This is what appears as a
 * USB CDC COM port on the host (e.g. COM12 on Windows).
 */
/ {
    chosen {
        /* zephyr,console tells Zephyr where printk() and printf() go. */
        zephyr,console = &usb_serial;

        /*
         * zephyr,shell-uart is optional, but useful if/when you enable
         * the Zephyr shell. It routes the shell I/O over the same USB
         * serial interface instead of a separate UART.
         */
        zephyr,shell-uart = &usb_serial;
    };
};

/*
 * &usb_serial:
 *
 * This is a reference to an existing node defined in the base board
 * devicetree describing the on-chip USB Serial/JTAG peripheral.
 *
 * By setting status = "okay" we tell Zephyr to enable it as a device.
 * Combined with zephyr,console = &usb_serial above, this makes printk
 * output appear on the USB CDC COM port on your host.
 */
&usb_serial {
    status = "okay";
};
```

## src/main.c
```c
#include <zephyr/kernel.h>
#include <zephyr/logging/log.h>
#include <zephyr/sys/util.h>

LOG_MODULE_REGISTER(debug_demo, LOG_LEVEL_DBG);

/* Global/static data to poke at with GDB watchpoints and memory reads. */
static uint32_t global_counter = 0x1234ABCD;
static uint8_t sensor_ring[8] = {0x11, 0x22, 0x33, 0x44, 0x55, 0x66, 0x77, 0x88};
static int static_seed = 7;

struct sample_state {
    int32_t accumulator;
    int16_t last_step;
    bool toggled;
};

static struct sample_state state = {
    .accumulator = 10,
    .last_step = -1,
    .toggled = false,
};

/*
 * Small helper you can breakpoint on:
 *   (gdb) break compute_next_step
 *   (gdb) break update_state
 */
static int compute_next_step(void)
{
    /* Create a small varying step based on CPU cycles and a static seed. */
    uint32_t tick = k_cycle_get_32();
    int step = (int)((tick & 0xFF) % 7) + static_seed;
    static_seed = (static_seed * 3 + 1) & 0xFF;
    return step;
}

/* Summation helper so you can inspect locals and return values. */
static uint32_t checksum8(const uint8_t *buf, size_t len)
{
    uint32_t sum = 0;
    for (size_t i = 0; i < len; i++) {
        sum += buf[i];
    }
    return sum;
}

/* Touch a buffer location to give you a predictable memory slot to examine. */
static void touch_memory(void)
{
    uint32_t idx = global_counter % ARRAY_SIZE(sensor_ring);
    sensor_ring[idx] ^= (uint8_t)(state.accumulator & 0xFF);
}

/* Central point to step through in GDB; toggles state and logs progress. */
static void update_state(void)
{
    int step = compute_next_step();
    state.accumulator += step;
    state.last_step = (int16_t)step;
    state.toggled = !state.toggled;
    global_counter++;

    uint32_t sum = checksum8(sensor_ring, ARRAY_SIZE(sensor_ring));
    touch_memory();

    LOG_DBG("step=%d acc=%d sum=0x%x counter=%u toggled=%d seed=%d",
            step, state.accumulator, sum, global_counter, state.toggled, static_seed);
}

int main(void)
{
    LOG_INF("Debug demo ready. Attach GDB and break on update_state().");
    LOG_INF("Example: west debug -d build/debug_demo -- -ex \"break update_state\"");

    while (1) {
        update_state();
        k_msleep(700);
    }

    return 0;
}
```
