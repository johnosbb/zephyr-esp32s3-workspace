## zephyr-esp32s3-course/west.yml
```yaml
manifest:
  self:
    path: zephyr-esp32s3-course

  remotes:
    - name: zephyrproject-rtos
      url-base: https://github.com/zephyrproject-rtos

  projects:
    - name: zephyr
      remote: zephyrproject-rtos
      revision: v4.0.0
      import:
        name-allowlist:
          - hal_espressif
          - cmsis
          - mbedtls
          - segger

  group-filter: [-optional]
```
